#include "task_cond_fan.h"
#include "FreeRTOS.h"
#include "task.h"
#include "event_groups.h"
#include "main.h"
#include "sys_state.h"
#include "sys_config.h"
#include "bsp_relay.h"
#include <stdbool.h>

/* ===========================================================================
 * 冷凝风机(3台)流程 (逻辑图6) — 实现文件
 *
 * 子逻辑:
 *   1. CondFan_MainProcess()   冷凝风机主逻辑
 *
 * 冷凝器原理:
 *   压缩机排出高温高压制冷剂气体, 经冷凝器散热后液化.
 *   冷凝器散热依靠风机吹风, 风机越多散热越快.
 *   冷凝温度过高 → 系统效率下降, 高压报警风险.
 *
 * 控制策略 (温度逻辑):
 *   根据冷凝温度 VAR_COND_TEMP 决定投入风机数量:
 *
 *   温度区间                      风机投入
 *   ─────────────────────────────────────
 *   ≥ SET_COND_FAN_ON_T (35℃)    温度较高, 需要多台风机散热
 *   ≤ SET_COND_FAN_OFF_T (25℃)   温度较低, 可以减少风机
 *
 *   阶梯投入 (3台):
 *     冷凝温度 ≥ 35℃                → 3台全开
 *     冷凝温度 在 30~35℃            → 2台开
 *     冷凝温度 在 25~30℃            → 1台开
 *     冷凝温度 < 25℃                → 全部关闭
 *
 *   温差阶梯 = (SET_COND_FAN_ON_T - SET_COND_FAN_OFF_T) / 2 = 5℃
 *   第1台开启: 25℃   第2台开启: 30℃   第3台开启: 35℃
 *
 * 当前控制方式: 继电器开关 (现有控制: 开关)
 * 未来扩展: EC风机485变频 / DC风机PWM (流程图标注)
 * =========================================================================== */


/* ===================================================================
 *  内部辅助函数 / 硬件操作桩
 * =================================================================== */

/* --- 冷凝风机开启 (K5 继电器, PC8, 1控3) --- */
static void CondFan_On(void)
{
    BSP_Relay_On(RELAY_COND_FAN);
    xEventGroupSetBits(SysEventGroup, ST_COND_FAN1_ON);
}

/* --- 冷凝风机关闭 --- */
static void CondFan_AllOff(void)
{
    BSP_Relay_Off(RELAY_COND_FAN);
    xEventGroupClearBits(SysEventGroup, ST_COND_FAN1_ON);
}


/* ===================================================================
 *  子逻辑1: 冷凝风机主逻辑
 *
 *  流程图 (6.冷凝风机流程.pdf):
 *
 *    开始
 *    → 读取设置值、测量值和定时标记
 *
 *    → 压缩机运行?
 *
 *      ┌─ N(压缩机未运行) ─────────────────────┐
 *      │  → 风机正在运行?                       │
 *      │    Y → 关闭风机 → 结束                 │
 *      │    N → 结束                            │
 *      │                                        │
 *      ├─ Y(压缩机运行) ──────────────────────┐ │
 *      │  → 风机正在运行?                      │ │
 *      │                                       │ │
 *      │    Y → 时间逻辑? (红色, TODO)         │ │
 *      │        → 结束 (未来扩展)              │ │
 *      │                                       │ │
 *      │    N → 温度逻辑                       │ │
 *      │        根据冷凝温度确定风机编号        │ │
 *      │        ┌──────────────────────┐       │ │
 *      │        │ 1: 确定风机编号(1台) │       │ │
 *      │        │ 2: 确定风机编号(2台) │       │ │
 *      │        │ 3: 确定风机编号(3台) │       │ │
 *      │        └──────┬───────────────┘       │ │
 *      │               ▼                       │ │
 *      │        开启风机                        │ │
 *      │        标记风机正在运行                 │ │
 *      │        → 结束                          │ │
 *      └────────────────────────────────────────┘ │
 *
 *  温度逻辑 — 阶梯投入:
 *    温差阶梯 = (ON温度 - OFF温度) / 2 = (35-25)/2 = 5℃
 *    T_step1 = OFF温度          = 25℃  → 开1台
 *    T_step2 = OFF温度 + 阶梯   = 30℃  → 开2台
 *    T_step3 = ON温度           = 35℃  → 开3台
 *    < OFF温度                          → 全关
 *
 *  调用时机: 每1秒由主循环调用一次
 * =================================================================== */
void CondFan_MainProcess(void)
{
    EventBits_t sys_bits = xEventGroupGetBits(SysEventGroup);

    bool comp_on = (sys_bits & ST_COMP_RUNNING) != 0;
    bool fan_on = (sys_bits & ST_COND_FAN1_ON) != 0;
    bool defrosting = (sys_bits & ST_DEFROST_ACTIVE) != 0;

    /* ================================================================
     *  第0步: 除霜中? → 关闭冷凝风机
     * ================================================================ */
    if (defrosting) {
        if (fan_on) {
            CondFan_AllOff();
        }
        return;
    }

    /* ================================================================
     *  第1步: 压缩机运行?
     * ================================================================ */
    if (!comp_on) {
        if (fan_on) {
            CondFan_AllOff();
        }
        return;
    }

    /* ================================================================
     *  Y → 压缩机运行中 → 温度逻辑控制风机
     *
     *  IO表标注: 冷凝温度>35℃开, <25℃关
     *  当前硬件: 1个继电器K5控3台风机, 只能全开/全关
     *  控制方式: 温度回差 (hysteresis)
     *    冷凝温度 ≥ SET_COND_FAN_ON_T  (35℃) → 开启
     *    冷凝温度 ≤ SET_COND_FAN_OFF_T (25℃) → 关闭
     *    25~35℃之间 → 保持当前状态 (防止频繁开关)
     *
     *  注: 逻辑图6的3路温度阶梯(1台/2台/3台)需要3个独立继电器
     *      或EC/PWM风机, 当前硬件不支持, 仅做温度回差开关控制
     * ================================================================ */
    SysVarData_t sensor;
    SysState_GetSensor(&sensor);
    float cond_temp = sensor.VAR_COND_TEMP;

    if (!fan_on) {
        /* 风机未运行 → 温度逻辑: 冷凝温度高于开启阈值才开 */
        if (cond_temp >= SET_COND_FAN_ON_T) {
            CondFan_On();
        }
    } else {
        /* 风机已运行 → 冷凝温度降到关闭阈值才关 */
        if (cond_temp <= SET_COND_FAN_OFF_T) {
            CondFan_AllOff();
        }
    }
}


/* ===================================================================
 *  冷凝风机任务主循环
 *
 *  作为FreeRTOS任务运行, 每1秒执行一轮:
 *    1. 冷凝风机主逻辑 (压缩机状态+冷凝温度→风机台数)
 *
 *  循环周期: 1秒
 * =================================================================== */
void Task_CondFan_Process(void const *argument)
{
    (void)argument;

    /* 初始化: 所有冷凝风机默认关闭 */
    CondFan_AllOff();

    /* 等待系统初始化完成 */
    vTaskDelay(pdMS_TO_TICKS(3000));

    for (;;) {
        /* ============================================
         * 冷凝风机主逻辑 (每秒执行)
         *   根据压缩机状态和冷凝温度控制风机
         * ============================================ */
        CondFan_MainProcess();

        /* 循环延时: 1秒 */
        vTaskDelay(pdMS_TO_TICKS(1000));
    }
}
